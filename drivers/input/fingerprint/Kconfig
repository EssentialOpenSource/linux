## drivers/input/fingerprint/Kconfig
```kconfig
#
# Configuration for FPC
#
menuconfig INPUT_FINGERPRINT
	bool "Fingerprints"
	help
	  Say Y here, and a list of supported fingerprints will be displayed.

if INPUT_FINGERPRINT

config INPUT_FPC1020
	bool "FPC 1020 Driver"
	default n
	help
	  This is a FPC 1020 chipset Driver.

endif
```

## drivers/nfc/cxd224x/Kconfig
```kconfig
#
# Near Field Communication (NFC) devices
#

config NFC_CXD224X
	tristate "CXD224X NFC driver"
	depends on I2C
	select CRC_CCITT
	default y
	---help---
	  Say yes if you want Sony cxd224x Near Field Communication driver.
	  This is for i2c connected version. If unsure, say N here.

	  To compile this driver as a module, choose m here. The module will
	  be called cxd224x-i2c.

config NFC_CXD224X_VEN
	tristate "CXD224X NFC VEN"
	depends on NFC_CXD224X
	default n
	---help---
	  Say yes if you want to use cxd224x NFC VEN(enable voltage) control.
	  If unsure, say N here.

config NFC_CXD224X_RST
	tristate "CXD224X NFC RST"
	depends on NFC_CXD224X
	default y
	---help---
	  Say yes if you want to use cxd224x NFC RST(external XRST pin) control.
```

## drivers/platform/essential/Kconfig
```kconfig
menu "Essential specific device drivers"
	depends on ARCH_QCOM

config ESSENTIAL_NV
	bool "Essential NV"
	default n
	help
	  Export NV information as virtual files

config ESSENTIAL_APR
	bool "Essential APR"
	default n
	help
	  Export APR information as virtual files

config ESSENTIAL_UFS
	bool "Essential UFS"
	default n
	help
	  Export UFS information as virtual files

config ESSENTIAL_SENSOR
	bool "Essential Sensor"
	default n
	help
	  Export Sensor information as virtual files

config ESSENTIAL_MFR
	bool "Essential MFR"
	default n
	help
	  Export MFR information as virtual files

config SIDECAR
	tristate "Sidecar Power bring up"
	help
	  Say 'y' here to include support for the Sidecar power
	  bring up driver.
	  This driver detect connected accessory and set the proper
	  power configuration (SOURCE/SINK)

config BOARD_MATA
	bool "Mata device support"
	depends on ARCH_MSM8998
	help
	 Say 'y' here to include Mata only modifications

config ESSENTIAL_SIBEAM
	bool "Essential SiBeam support"
	default n
	help
	  Enable SiBeam support for Essential board

endmenu
```
